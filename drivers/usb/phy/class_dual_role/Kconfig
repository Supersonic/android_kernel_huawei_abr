## drivers/usb/phy/class_dual_role/Kconfig
```kconfig
config DUAL_ROLE_USB_INTF
	bool "Generic DUAL ROLE sysfs interface"
	depends on SYSFS && USB_PHY
	help
	  A generic sysfs interface to track and change the state of
	  dual role usb phys. The usb phy drivers can register to
	  this interface to expose it capabilities to the userspace
	  and thereby allowing userspace to change the port mode.
```

## drivers/vibrator/Kconfig
```kconfig
config HUAWEI_VIBRATOR
	tristate "huawei vibrator driver"
	default y
	help
		If you yes here to support the huawei vibrator driver.
```

## fs/hmdfs/d2dp/Kconfig
```kconfig
config D2D_PROTOCOL
	tristate "D2D Protocol"
	depends on INET
	help
	  This enables building D2D-over-UDP Protocol. D2DP/UDP is a new fast
	  transport protocol designed for local WiFi networks with low drop
	  rate (WiFi-Direct or Soft-AP with no intermediate hops)

	  This protocol now works only in kernel space so if your application
	  does not run in kernelspace, say N here.

config D2D_PROTOCOL_TRACING
	bool "D2D tracing"
	depends on D2D_PROTOCOL
	default n
	help
	  Enable tracing code for D2D Protocol with useful diagnostic info.
	  It may increase the image size so if unsure, say N
```

## kernel/rainbow/Kconfig
```kconfig
config RAINBOW
    default n
      bool "rainbow"
    help
      rainbow framework.

config RAINBOW_REASON
    depends on RAINBOW
    default n
      bool "rainbow_reason"
    help
      rainbow reason record reset reason.

config RAINBOW_HIMNTN
    depends on RAINBOW
    default n
      bool "rainbow_himntn"
    help
      rainbow himntn control kernel mntn.

config RAINBOW_TRACE
    depends on RAINBOW
    default n
      bool "rainbow_reason"
    help
      rainbow trace will record irq and schedule trace log.
```

## security/kernel_harden_test/Kconfig
```kconfig
config KERNEL_HARDEN_DEBUG
	bool "kernel harden test support"
	default n
	help
	  Say yes here to support the kernel harden debug
```

## sound/adsp_misc/Kconfig
```kconfig
config HUAWEI_QCOM_ADSP_MISC
	tristate "adsp_misc driver"
	default n
	help
		Say Y to enable adsp_misc driver support
```

## sound/hw_audio/Kconfig
```kconfig
config HW_AUDIO_INFO
    tristate "set audio info for self adapt"
	default n
	help
	  This is used to some audio self adatper configuration.
```

## sound/smartpa/Kconfig
```kconfig
source "sound/smartpa/aw882xx/Kconfig"
source "sound/smartpa/aw882xx_v2/Kconfig"
source "sound/smartpa/cs35lxx/Kconfig"
source "sound/smartpa/tfa98xx/Kconfig"
```

## sound/smartpa/aw882xx/Kconfig
```kconfig
config SND_SOC_AW882XX
    tristate "set audio info for self adapt"
	default n
    help
      aw882xx driver.
```

## sound/smartpa/aw882xx_v2/Kconfig
```kconfig
config SND_SOC_AW882XX_V2
    tristate "set audio info for self adapt"
	default n
    help
      aw882xx_v2 driver.
```

## sound/smartpa/cs35lxx/Kconfig
```kconfig
config SND_SOC_CS35LXX
	tristate "cs35lxx driver"
	default n
	help
		Say Y to enable  cs35lxx driver support
```

## techpack/camera/drivers/cam_sensor_module/cam_laser/tmf880x/Kconfig
```kconfig
config SENSORS_TMF8801
	tristate "AMS-TAOS TMF8801 TOF"
    	depends on I2C
	default n
 	help
	  If you say yes here you get support for the ams-taos tmf8801,
	  ToF distance sensors.
​
	  This driver can also be built as a module.  If so, the module
	  will be called tmf8801.
```
