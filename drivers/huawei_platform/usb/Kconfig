## drivers/huawei_platform/usb/Kconfig
```kconfig
source "drivers/huawei_platform/usb/pd/Kconfig"
source "drivers/huawei_platform/usb/switch/Kconfig"
source "drivers/huawei_platform/usb/ulog_trace/Kconfig"
source "drivers/huawei_platform/usb/cust_attr/Kconfig"
source "drivers/huawei_platform/usb/function-huawei/Kconfig"
source "drivers/huawei_platform/usb/usb_extra_modem/Kconfig"
```

## drivers/huawei_platform/usb/cust_attr/Kconfig
```kconfig
config CUST_ATTR_GLINK
	bool "huawei custom attributes glink driver"
	default n
	help
	  Enable this option to tranfer custom attributes to adsp.
```

## drivers/huawei_platform/usb/function-huawei/Kconfig
```kconfig
# SPDX-License-Identifier: GPL-2.0
#
# Huawei Extended Functions
#

config HWUSB_EXT_FUNC
	bool "Extended Gadget Function Driver"
	default n
	help
	  Say Y here to enable huawei extended functions.

config HWUSB_F_MTP
	bool "Gadget Function Driver for MTP"
	default n
	depends on HWUSB_EXT_FUNC
	help
	  Say Y here to enable f_mtp driver.

config HWUSB_F_PTP
	bool "Gadget Function Driver for PTP"
	default n
	depends on HWUSB_EXT_FUNC
	help
	  Say Y here to enable f_ptp driver.
```

## drivers/huawei_platform/usb/ulog_trace/Kconfig
```kconfig
config ULOG_TRACE
	bool "huawei ulog trace driver"
	default n
	help
	  Enable this option to trace adsp log.
```

## drivers/hw_devices/Kconfig
```kconfig
config HUAWEI_DEVICE_DETCET    
         bool "huawei_device_detect support"
        default n
```

## drivers/hwdps/Kconfig
```kconfig
config HWDPS
	bool "hwdps System"
	default n
	help
	Huawei Application Authentication System

config HWDPS_ENG_DEBUG
	bool "application authentication for eng debug"
	default n
	help
		Say yes here to support application authentication eng debug.
```

## drivers/hwsensor/Kconfig
```kconfig
config HUAWEI_HALL_SENSORS
        bool "huawei hall sensors"
		default n
        help
          Say Y here if you want to build the huawei hall sensor drivers.
		  If unsure, say N here.

config HUAWEI_LP_SENSORS
        bool "huawei als and proximity sensors"
		default n
        help
          Say Y here if you want to build the huawei als and proximity sensor drivers.
		  If unsure, say N here.

source "drivers/hwsensor/lpsensor/Kconfig"
config SENSOR_DEVELOP_TEST
        bool "Support for sensor develop selftest"
		default n
        help
          Say Y here if you want to build develop test sensor connected with ap side.
		  If unsure, say N here.

config HUAWEI_SENSOR_INFO
        tristate "Support for sensor self_adapt"
        default n
        help
          Say Y to enable support self-adapt

config HUAWEI_PS_SENSOR
        bool "huawei ps sensor"
		default n
        help
          Say Y here if you want to build the huawei thp sensor drivers.
		  If unsure, say N here.

source "drivers/hwsensor/pssensor/Kconfig"

config HUAWEI_SAR_SENSOR
        bool "huawei sar sensor"
		default y
        help
          Say Y here if you want to build the huawei sar sensor drivers.
		  If unsure, say N here.

source "drivers/hwsensor/sarsensor/Kconfig"

config HUAWEI_EXTRA_IR_MODE
        bool "huawei extra ir mode"
		default n
        help
          Say Y here if you want to build the huawei thp sensor drivers.
		  If unsure, say N here.

source "drivers/hwsensor/extra_ir_mode/Kconfig"

config HUAWEI_HORIZONTAL_MODE
        bool "huawei horizontal mode"
		default n
        help
          Say Y here if you want to build the huawei thp sensor drivers.
		  If unsure, say N here.

source "drivers/hwsensor/acc_horizontal_mode/Kconfig"

config HUAWEI_COLOR_SENSOR
        bool "huawei color sensor"
		default y
        help
          Say Y here if you want to build the huawei color sensor drivers.
		  If unsure, say N here.

source "drivers/hwsensor/color_sensor/Kconfig"
```

## drivers/hwsensor/apsensor_channel/Kconfig
```kconfig
#
# FLP driver configuration
#

menu "SMART FLP configuration"

config SMART_SOFTTIMER
	bool "SMART SOFTTIMER support"
	default y
	help
	  Enable support for softtimer driver

config SMART_FLP
	bool "SMART FLP support"
	default y
	help
	  Enable support for FLP driver

config SMART_FLP_GEOFENCE
	bool "SMART FLP GEOFENCE support"
	default y
	help
	  Enable support for GEOFENCE driver

config SMART_FLP_CELLFENCE
	bool "SMART FLP CELLFENCE support"
	default y
	help
	  Enable support for CELLFENCE driver

config SMART_FLP_WIFIFENCE
	bool "SMART_FLP_WIFIFENCE support"
	default y
	help
	  Enable support for WIFIFENCE driver

config SMART_FLP_BATCHING
	bool "SMART_FLP_BATCHING support"
	default y
	help
	  Enable support for BATCHING driver

config SMART_FLP_DIAG
	bool "SMART_FLP_DIAG support"
	default y
	help
	  Enable support for DIAG driver

config SMART_AR
	bool "SMART AR support"
	default n
	help
	  Enable support for AR driver

config CONTEXTHUB_UNIFORM_INTERVAL
	bool "SMART CONTEXTHUB_UNIFORM_INTERVAL support"
	default n
	help
	  Enable support for CONTEXTHUB_UNIFORM_INTERVAL driver

config SMART_TIMER_V500
	bool "SMART TIMER V500 support"
	default n
	help
	  Enable support for timer driver of v500
endmenu

menuconfig HUAWEI_SENSOR
    bool "Huawei sensors info"
    default n
    help
      Say yes if you want device detect driver.
      This is for device connected version. If unsure, say N here.
```

## drivers/hwsensor/color_sensor/Kconfig
```kconfig
config SENSORS_COLOR_AP
	tristate "XYZ Color sensor"
	depends on I2C && SYSFS && HUAWEI_COLOR_SENSOR
	default y
     help
     Say Y to enable support ap color sensor
config TCS3430_AMS_DEBUG_LOG
    bool "Enable debug logging"
    depends on SENSORS_COLOR_AP
    default n
```

## drivers/hwsensor/extra_ir_mode/Kconfig
```kconfig
config SENSORS
  bool "Sensors Class Support"
  depends on HUAWEI_EXTRA_IR_MODE
  default y
  help
    This option enables the sensor sysfs class in /sys/class/sensors.
    You'll need this to do anything useful with sensors. If unsure, say N.
```

## drivers/hwsensor/pssensor/Kconfig
```kconfig
config SENSORS
  bool "Sensors Class Support"
  depends on HUAWEI_PS_SENSOR
  default y
  help
    This option enables the sensor sysfs class in /sys/class/sensors.
    You'll need this to do anything useful with sensors. If unsure, say N.
config HUAWEI_TP_PS_SENSOR
        tristate "Support for ps sensor"
        depends on HUAWEI_PS_SENSOR
        default y
        help
          Say Y to enable support ps sensor
```

## drivers/hwsensor/sarsensor/Kconfig
```kconfig
config HUAWEI_SAR_SENSOR_ABOV
        tristate "Support for sar sensor A96T356"
        depends on HUAWEI_SAR_SENSOR
        default n
        help
          Say Y to enable support A96T356 sar sensor
```

## drivers/hwsensor/xhub_router/Kconfig
```kconfig
config HUAWEI_XHUB_ROUTER
    tristate "huawei xhub router"
	default y
	help
	  Say Y here.
```

## drivers/irda/Kconfig
```kconfig
config HUAWEI_IR_CORE
	bool "huawei infrared user interface"
	default n
	help
	  Enable this option to enable the infrared user interface
	  (e.g. /dev/ir). This interface passes infrared CIR data
	  to or from userspace, which is needed for IR transmitting
	  (aka "blasting") and for the ir daemon.

config HUAWEI_IR_PWM
	bool "huawei PWM IR transmitter"
	depends on PWM && HUAWEI_IR_CORE
	---help---
	   Say Y if you want to use a PWM based IR transmitter.
```

## drivers/modem_reset/Kconfig
```kconfig
#
# Huawei modem reset
#
config MODEM_RESET
	tristate "Huawei modem reset"
	default y
```

## drivers/nfc/Kconfig
```kconfig
#
# Near Field Communication (NFC) devices
#

menu "Near Field Communication (NFC) devices"
#	depends on NFC

# add by huawei
config NFC_PN533
	tristate "NXP PN533 USB driver"
	depends on USB
	help
	  NXP PN533 USB driver.
	  This driver provides support for NFC NXP PN533 devices.

	  Say Y here to compile support for PN533 devices into the
	  kernel or say M to compile it as module (pn533).


# add by huawei
config NFC_PN547
	tristate "PN547 NFC driver"
	depends on I2C
	help
	  NXP PN547 driver.

# add by huawei
source "drivers/nfc/pn547/Kconfig"
endmenu
```

## drivers/power/charger/Kconfig
```kconfig
config HUAWEI_DSM
	bool "huawei power dsm"

config HUAWEI_BATT
	bool "huawei batt"
```

## drivers/power/huawei_adc/Kconfig
```kconfig
config HUAWEI_ADC
        bool "Adc supply debug"
            default y
        help
          Say Y here to enable debugging messages for huawei adc
          and drivers.
```

## drivers/soc/qcom/pil-q6v5-mss/Kconfig
```kconfig
#
# Huawei modem interface
#
config HUAWEI_MODEM_CRASH_LOG
	tristate "modem crash exception for apr"
	default y
```

## drivers/staging/android/Kconfig
```kconfig
# SPDX-License-Identifier: GPL-2.0
menu "Android"

if ANDROID

config ASHMEM
	bool "Enable the Anonymous Shared Memory Subsystem"
	depends on SHMEM
	help
	  The ashmem subsystem is a new shared memory allocator, similar to
	  POSIX SHM but with different behavior and sporting a simpler
	  file-based API.

	  It is, in theory, a good memory allocator for low-memory devices,
	  because it can discard shared memory units when under memory pressure.

config ANDROID_VSOC
	tristate "Android Virtual SoC support"
	depends on PCI_MSI
	help
	  This option adds support for the Virtual SoC driver needed to boot
	  a 'cuttlefish' Android image inside QEmu. The driver interacts with
	  a QEmu ivshmem device. If built as a module, it will be called vsoc.

config ANDROID_LOW_MEMORY_KILLER
	bool "Android Low Memory Killer"
	---help---
	  Registers processes to be killed when low memory conditions, this is useful
	  as there is no particular swap space on android.

	  The registered process will kill according to the priorities in android init
	  scripts (/init.rc), and it defines priority values with minimum free memory size
	  for each priority.

config HUAWEI_LMK_DBG
        bool "HUAWEI Low Memory Killer debug"
        default n
        depends on ANDROID_LOW_MEMORY_KILLER
        ---help---
          print processes info when lmk happen per several seconds
config HUAWEI_RCC
	tristate "RAM Compress and Clean"
	depends on SYSFS && SWAP
	default n
	help
	  Creates background thread for compress and clean used RAM
	  dynamiclly,enabled by write 1 to /sys/kernel/rcc/enable.

config HUAWEI_RCC_DEBUG
	bool "RAM Compress and Clean debug support"
	depends on HUAWEI_RCC
	default n
	help
	  This option adds additional debugging code to the
	  RAM Compress and Clean module.

source "drivers/staging/android/ion/Kconfig"

source "drivers/staging/android/hwlogger/Kconfig"

endif # if ANDROID

endmenu
```

## drivers/usb/otg_dual_role/Kconfig
```kconfig
config OTG_DUAL_ROLE
	tristate "OTG_DUAL_ROLE support"
	default n
	help
	  Say Y here to enable dummy otg dual role driver.
```
