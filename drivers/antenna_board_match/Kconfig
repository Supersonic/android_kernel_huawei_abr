## drivers/devkit/tpkit/3_0/panel/chipone_hybrid/Kconfig
```kconfig
#
# huawei touchscreen driver configuration
#

menuconfig CHIPONE_HYBRID_TS_KIT_3_0
	tristate "CHIPONE_HYBRID drivers"
	default n
	help
	  If you say yes here you get support for huawei touchscreen.
```

## drivers/devkit/tpkit/3_0/panel/zinitix/Kconfig
```kconfig
#
# huawei touchscreen driver configuration
#

menuconfig ZINITIX_TS_KIT_3_0
	tristate "TS_KIT_3_0 zinitix drivers"
	default n
	help
	  If you say yes here you get support for huawei touchscreen.
```

## drivers/dp/Kconfig
```kconfig
config HUAWEI_DP_AUX
	bool "huawei dp aux driver"
	help
	  Enable this option to enable the dp aux
config HUAWEI_DP_SOURCE
	bool "huawei dp source switch driver"
	help
	  Enable this option to enable the dp source switch
```

## drivers/huawei/Kconfig
```kconfig
menu "huawei linux device driver support package"
	source "drivers/huawei/memory/Kconfig"
endmenu
```

## drivers/huawei_platform/Kconfig
```kconfig
config HUAWEI_DRIVERS
	bool "huawei drivers"
	default y
	help
	  Say Y here if you want to build the huawei drivers.
	  If unsure, say N here.
config HUAWEI_TOUCH_SCREEN
	bool "huawei touch screen driver"
	default y
	help
	  Say Y here if you have any touch device connected to your system and want
	  it to be available to applications. 
	  Say N here if you have no touch device in your system.If unsure, say Y.
	  To compile this driver as a module, choose M here: the  module will be called input.

#source "drivers/huawei_platform/log/Kconfig"
source "drivers/huawei_platform/mntn/Kconfig"
source "drivers/huawei_platform/ioinfo/Kconfig"
source "drivers/huawei_platform/usb/Kconfig"
source "drivers/huawei_platform/power/Kconfig"
source "drivers/huawei_platform/hwpower/Kconfig"
source "drivers/huawei_platform/net/Kconfig"
source "drivers/huawei_platform/gpu_stats/Kconfig"
source "drivers/huawei_platform/hwthermal/Kconfig"
source "drivers/huawei_platform/comb_key/Kconfig"
source "drivers/huawei_platform/hw_vpu/Kconfig"
source "drivers/huawei_platform/hw_drg/Kconfig"
```

## drivers/huawei_platform/gpu_stats/Kconfig
```kconfig
#
#  gpu opp stat
#

config HUAWEI_GPU_OPP_STATS
	bool "huawei gpu opp stats"
	default n
	help
	  Switch to enable huawei gpu opp stats
```

## drivers/huawei_platform/hw_drg/Kconfig
```kconfig
config DRG
	bool "dual rail governor"
	default y
	help
	 manager frequency dependency caused by dual rail between
	 different cpufreq device and devfreq device.
```

## drivers/huawei_platform/hw_vpu/Kconfig
```kconfig
#
# VPU freq scale configuration
#

config HW_VPU_SCALE
	bool "huawei vpu freq scale"
	default y
	help
	  Switch to enable the huawei vpu freq scale file
	  Say Y here to enable vpu freq scale
```

## drivers/huawei_platform/hwpower/Kconfig
```kconfig
# SPDX-License-Identifier: GPL-2.0
source "drivers/huawei_platform/hwpower/proxy/Kconfig"
source "drivers/huawei_platform/hwpower/glink/Kconfig"
source "drivers/huawei_platform/hwpower/hardware_ic/Kconfig"
```

## drivers/huawei_platform/hwpower/glink/Kconfig
```kconfig
# SPDX-License-Identifier: GPL-2.0
config HUAWEI_POWER_GLINK
	bool "huawei power glink"
	default n
	help
	  Say Y here to enable power glink driver.
```

## drivers/huawei_platform/hwpower/hardware_ic/Kconfig
```kconfig
# SPDX-License-Identifier: GPL-2.0
source "drivers/huawei_platform/hwpower/hardware_ic/switch_capacitor/Kconfig"
```

## drivers/huawei_platform/hwpower/hardware_ic/switch_capacitor/Kconfig
```kconfig
# SPDX-License-Identifier: GPL-2.0
#
# huawei switch capacitor for direct charge drivers
#

config SCHARGER_V600
	bool "scharger_v600_for_direct_charge"
	depends on SWITCHCAP
	default n
	help
	  Say Y here to enable scharge_v600 driver.
	  scharge_v600 is a fixed ratio high voltage high power switched capacitor
	  and low voltage loadswtich ic.
```

## drivers/huawei_platform/hwpower/proxy/Kconfig
```kconfig
# SPDX-License-Identifier: GPL-2.0
config HUAWEI_POWER_PROXY
	bool "huawei power proxy"
	default n
	help
	  Say Y here to enable power proxy driver.
	  This driver provides interfaces to get battery operation
	  information for platform charger when using tripartite coulometer.
```

## drivers/huawei_platform/mntn/Kconfig
```kconfig
config HUAWEI_PLATFORM_MAINTAIN
	bool "Huawei platform maintain module support"
	default n
	help
	  Say yes here to support the huawei platform maintain module

config HUAWEI_PLATFORM_EASYSHELL
	bool "Support Huawei Easy Shell"
	default n
	help
	  This driver supports easy shell, etc.

source "drivers/huawei_platform/mntn/blackbox/Kconfig"
```

## drivers/huawei_platform/mntn/blackbox/Kconfig
```kconfig
menu "Huawei DFX panic recorder"

config HUAWEI_BB
	bool "huawei kernel panic recorder"
	depends on SYSFS
	default n
	help
	  This module can record kernel panic info, parse & save into file-system.
	  Include:
	  dmesg, task, etc ...

endmenu
```

## drivers/huawei_platform/power/charger/charger_ap/Kconfig
```kconfig
source "drivers/huawei_platform/power/charger/charger_ap/direct_charger/Kconfig"
source "drivers/huawei_platform/power/charger/charger_ap/huawei_charger/Kconfig"
source "drivers/huawei_platform/power/charger/charger_ap/wireless_charge/Kconfig"
```

## drivers/huawei_platform/power/charger/charger_ap/huawei_charger/Kconfig
```kconfig
config HUAWEI_CHARGER
        bool "huawei charger"
        default n
config FCP_CHARGER
        bool "fcp charger"
        default n
```

## drivers/huawei_platform/power/charger/charger_ap/wireless_charge/Kconfig
```kconfig
config WIRELESS_CHARGER
       bool "wireless charger"
       default n
       help
         Say Y here to enable wireless charge driver.
         This driver provides a unified logic to the wireless charge.
         Currently supported wireless protocols as below:
         QI/WPC protocol.

config WIRELESS_ACCESSORY
        bool "wireless accessory"
        default n
        help
          Say Y here to enable wireless accessory driver.
          The wireless accessory support wireless charging for huawei wireless pen
```

## drivers/huawei_platform/power/dubai/Kconfig
```kconfig
config HUAWEI_DUBAI_GPU_STATS
	bool "Dubai gpu frequency stats"
	default n
	depends on HUAWEI_DUBAI && HUAWEI_GPU_OPP_STATS

config HUAWEI_DUBAI_DDR_STATS
	bool "Dubai ddr stats"
	default n
	depends on HUAWEI_DUBAI
```

## drivers/huawei_platform/power/hardware_ic/wireless_charge_ic/Kconfig
```kconfig
#
# wireless charge ic driver
#

config WIRELESS_STWLC33
	bool "wireless stwlc33"
	depends on WIRELESS_CHARGER
	default n
	help
	  Say Y here to enable stwlc33 driver.
	  The stwlc33 is an soc for magnetic induction
	  based wireless power receiver. it is fully compliant
	  with latest WPC Qi specification of BPP and EPP
	  and also supports various proprietary fast charging
	  protocols used by major smart phone OEM.
```

## drivers/huawei_platform/radiobuckboost/Kconfig
```kconfig
config RADIO_BUCKBOOST
	bool "Radio buckboost support"
	default n
	help
	  Buckboost for radio

config RADIO_BUCKBOOST_TPS6381X
	bool "Enable tps63810 for radio Driver"
	default n
```
