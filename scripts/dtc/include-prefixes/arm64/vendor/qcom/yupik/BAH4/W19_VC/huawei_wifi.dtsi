&huawei_wifi_info{
    compatible = "huawei,hw_wifi_info";
    status = "ok";
    wifi,pubfile_id = "bah4_w19";
    wifi,chiptype = "WIFI_QUALCOMM_WCN6750";
};

&singleap_wifionly {
    compatible = "huawei,singleap_wifionly";
    is_wifionly = "1";
    status = "ok";
};
