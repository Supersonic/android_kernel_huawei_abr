/* Copyright (c) 2013, The Linux Foundation. All rights reserved.
 *
 * This program is free software; you can redistribute it and/or modify
 * it under the terms of the GNU General Public License version 2 and
 * only version 2 as published by the Free Software Foundation.
 *
 * This program is distributed in the hope that it will be useful,
 * but WITHOUT ANY WARRANTY; without even the implied warranty of
 * MERCHANTABILITY or FITNESS FOR A PARTICULAR PURPOSE.  See the
 * GNU General Public License for more details.
 */

/*-------------------------------------------------------------------------
 * This file is autogenerated file using gcdb parser. Please do not edit it.
 * Update input XML file to add a new entry or update variable in this file
 * VERSION = 1.1
 *-----------------------------------------------------------------------*/
&mdss_mdp {
	dsi_bal_190_20f_6p85_qcom: lcd_kit_bal_190_20f_6p85_qcom {
		compatible = "190_20f_6p85";
		lcd-kit,panel-name = "190_20f 6.85' 1188 x 2790";
		lcd-kit,panel-type = <0x02>;
		lcd-kit,panel-aod-high-brightness-cmds = <0x39 0x01 0x00 0x00 0x0a 0x00 0x05 0x51 0x00 0x00 0x0F 0xFE>;
		lcd-kit,panel-aod-low-brightness-cmds = <0x39 0x01 0x00 0x00 0x0a 0x00 0x05 0x51 0x00 0x00 0x00 0x0A>;
		lcd-kit,panel-aod-no-brightness-cmds = <0x39 0x01 0x00 0x00 0x0a 0x00 0x05 0x51 0x00 0x00 0x00 0x00>;
		lcd-kit,panel-aod-middle-brightness-cmds = <0x39 0x01 0x00 0x00 0x0a 0x00 0x05 0x51 0x00 0x00 0x03 0xE8>;
		lcd-kit,pcd-check-reg-cmds = <0xCB>;
		lcd-kit,check-reg-on-cmds = <0x06 0x01 0x00 0x00 0x0a 0x00 0x01 0x0a>;
		lcd-kit,check-reg-on-value = <0x9c>;
		lcd-kit,check-aod-reg-on-cmds = <0x06 0x01 0x00 0x00 0x0a 0x00 0x01 0x0a>;
		lcd-kit,check-aod-reg-on-value = <0xdc>;
		lcd-kit,check-reg-off-cmds = <0x06 0x01 0x00 0x00 0x0a 0x00 0x01 0x0a>;
		lcd-kit,check-reg-off-value = <0x08>;
		lcd-kit,check-reg-on-cmds-state = "dsi_lp_mode";
		lcd-kit,check-aod-reg-on-cmds-state = "dsi_lp_mode";
		lcd-kit,check-reg-off-cmds-state = "dsi_lp_mode";
		lcd-kit,pcd-check-reg-value = <0xCB>;
		lcd-kit,pcd-errflag-check-support = <0>;
		lcd-kit,checksum-enable-cmds = <0x29 0x01 0x00 0x00 0x14 0x01 0x05 0xFF 0xAA 0x55 0xA5 0x80
			0x15 0x01 0x00 0x00 0x0a 0x00 0x02 0xF2 0x03>;
		lcd-kit,checksum-enable-cmds-state = "dsi_lp_mode";
		lcd-kit,checksum-disable-cmds = <0x29 0x01 0x00 0x00 0x14 0x01 0x05 0xFF 0xAA 0x55 0xA5 0x80
			0x15 0x01 0x00 0x00 0x0a 0x00 0x02 0xF2 0x00>;
		lcd-kit,checksum-disable-cmds-state = "dsi_lp_mode";
		lcd-kit,checksum-cmds = <0x15 0x01 0x00 0x00 0x0a 0x00 0x02 0x6F 0x01
			0x06 0x01 0x00 0x00 0x0a 0x00 0x08 0xF2 0x00 0x00 0x00 0x00 0x00 0x00 0x00>;
		lcd-kit,checksum-cmds-state = "dsi_lp_mode";
		lcd-kit,checksum-value = <0xb8 0xed 0x1c 0xd2 0xe6 0x9f 0xe0 0x61
			0xe9 0x9d 0x22 0xc1 0xbe 0x44 0x2a 0xae
			0xbc 0x51 0x65 0xe6 0x19 0x4e 0x21 0x05>;
		lcd-kit,color-aod-detect-enter = <0x39 0x01 0x00 0x00 0x00 0x00 0x02 0x2F 0x01
		0x05 0x01 0x00 0x00 0x00 0x00 0x01 0x39
		0x05 0x01 0x00 0x00 0x00 0x00 0x01 0x2C
		0x39 0x01 0x00 0x00 0x00 0x00 0x05 0x51 0x00 0x00 0x0E 0xFE>;
		lcd-kit,color-aod-detect-enter-state = "dsi_lp_mode";
		lcd-kit,color-aod-detect-exit = <0x05 0x01 0x00 0x00 0x00 0x00 0x01 0x38
		0x05 0x01 0x00 0x00 0x00 0x00 0x01 0x2C
		0x39 0x01 0x00 0x00 0x22 0x00 0x02 0x2F 0x01>;
		lcd-kit,color-aod-detect-exit-state = "dsi_lp_mode";
		lcd-kit,pcd-read-cmds = <0x39 0x01 0x00 0x00 0x00 0x00 0x06 0xF0 0x55 0xAA 0x52 0x08 0x01
		0x39 0x01 0x00 0x00 0x00 0x00 0x05 0xD0 0x00 0x31 0x00 0x00
		0x05 0x01 0x00 0x00 0x78 0x00 0x01 0x11
		0x05 0x01 0x00 0x00 0x0a 0x00 0x01 0x29
		0x14 0x01 0x00 0x00 0x0a 0x00 0x03 0xD0 0x02 0x00>;
		lcd-kit,pcd-read-cmds-state  = "dsi_lp_mode";
		lcd-kit,vtc-line-cmds = <0x39 0x01 0x00 0x00 0x00 0x00 0x06 0xF0 0x55 0xAA 0x52 0x00 0x00
		0x39 0x01 0x00 0x00 0x00 0x00 0x05 0xFF 0xAA 0x55 0xA5 0x80
		0x39 0x01 0x00 0x00 0x00 0x00 0x05 0xFF 0xAA 0x55 0xA5 0x81
		0x39 0x01 0x00 0x00 0x00 0x00 0x05 0xFF 0xAA 0x55 0xA5 0x00
		0x15 0x01 0x00 0x00 0x00 0x00 0x02 0x35 0x00
		0x15 0x01 0x00 0x00 0x00 0x00 0x02 0x53 0x20
		0x39 0x01 0x00 0x00 0x00 0x00 0x05 0x51 0x07 0xBB 0x0F 0xFE
		0x39 0x01 0x00 0x00 0x00 0x00 0x05 0x2A 0x00 0x00 0x04 0xA3
		0x39 0x01 0x00 0x00 0x00 0x00 0x05 0x2B 0x00 0x00 0x0A 0xE5
		0x15 0x01 0x00 0x00 0x00 0x00 0x02 0x82 0xA8
		0x15 0x01 0x00 0x00 0x00 0x00 0x02 0x03 0x01
		0x15 0x01 0x00 0x00 0x00 0x00 0x02 0x90 0x01
		0x39 0x01 0x00 0x00 0x00 0x00 0x13 0x91 0x89 0x28 0x00 0x1E 0xC2 0x00 0x03 0x52 0x03 0xFC 0x00 0x10 0x03 0x50 0x01 0x8B 0x10 0xF0
		0x05 0x01 0x00 0x00 0x00 0x00 0x01 0x2C
		0x39 0x01 0x00 0x00 0x00 0x00 0x06 0xF0 0x55 0xAA 0x52 0x08 0x00
		0x15 0x01 0x00 0x00 0x00 0x00 0x02 0x6F 0x05
		0x39 0x01 0x00 0x00 0x00 0x00 0x06 0xB5 0x7F 0x4E 0x1F 0x4F 0x54
		0x15 0x01 0x00 0x00 0x00 0x00 0x02 0x6F 0x0B
		0x39 0x01 0x00 0x00 0x00 0x00 0x05 0xB5 0x4E 0x25 0x50 0x54
		0x15 0x01 0x00 0x00 0x00 0x00 0x02 0x6F 0x10
		0x39 0x01 0x00 0x00 0x00 0x00 0x06 0xB5 0x1F 0x1F 0x1F 0x1F 0x1F
		0x39 0x01 0x00 0x00 0x00 0x00 0x06 0xF0 0x55 0xAA 0x52 0x08 0x00
		0x15 0x01 0x00 0x00 0x00 0x00 0x02 0x6F 0x08
		0x15 0x01 0x00 0x00 0x00 0x00 0x02 0xB5 0x50
		0x15 0x01 0x00 0x00 0x00 0x00 0x02 0x6F 0x0D
		0x15 0x01 0x00 0x00 0x00 0x00 0x02 0xB5 0x50
		0x39 0x01 0x00 0x00 0x00 0x00 0x06 0xF0 0x55 0xAA 0x52 0x08 0x00
		0x15 0x01 0x00 0x00 0x00 0x00 0x02 0x6F 0x06
		0x15 0x01 0x00 0x00 0x00 0x00 0x02 0xB5 0x4F
		0x39 0x01 0x00 0x00 0x00 0x00 0x06 0xF0 0x55 0xAA 0x52 0x08 0x01
		0x39 0x01 0x00 0x00 0x00 0x00 0x03 0xB5 0x00 0xF8
		0x39 0x01 0x00 0x00 0x00 0x00 0x03 0xB6 0x01 0x60
		0x15 0x01 0x00 0x00 0x00 0x00 0x02 0xCF 0x00
		0x39 0x01 0x00 0x00 0x00 0x00 0x06 0xF0 0x55 0xAA 0x52 0x08 0x00
		0x15 0x01 0x00 0x00 0x00 0x00 0x02 0xC5 0x01
		0x39 0x01 0x00 0x00 0x00 0x00 0x06 0xF0 0x55 0xAA 0x52 0x08 0x05
		0x15 0x01 0x00 0x00 0x00 0x00 0x02 0xEC 0x01
		0x39 0x01 0x00 0x00 0x00 0x00 0x06 0xF0 0x55 0xAA 0x52 0x08 0x01
		0x39 0x01 0x00 0x00 0x00 0x00 0x03 0xB0 0x0D 0x0D
		0x39 0x01 0x00 0x00 0x00 0x00 0x03 0xB1 0x08 0x08
		0x39 0x01 0x00 0x00 0x00 0x00 0x03 0xB3 0x25 0x25
		0x39 0x01 0x00 0x00 0x00 0x00 0x07 0xB7 0x5A 0x5A 0x5A 0x5A 0x5A 0x5A
		0x39 0x01 0x00 0x00 0x00 0x00 0x06 0xF0 0x55 0xAA 0x52 0x08 0x01
		0x39 0x01 0x00 0x00 0x00 0x00 0x03 0xB4 0x25 0x25
		0x39 0x01 0x00 0x00 0x00 0x00 0x05 0xB8 0x5F 0x5F 0x5F 0x5F
		0x39 0x01 0x00 0x00 0x00 0x00 0x06 0xF0 0x55 0xAA 0x52 0x08 0x06
		0x39 0x01 0x00 0x00 0x00 0x00 0x06 0xB0 0x32 0x31 0x31 0x13 0x13
		0x39 0x01 0x00 0x00 0x00 0x00 0x06 0xB1 0x12 0x12 0x32 0x00 0x00
		0x39 0x01 0x00 0x00 0x00 0x00 0x06 0xB2 0x0F 0x0F 0x0E 0x0E 0x32
		0x15 0x01 0x00 0x00 0x00 0x00 0x02 0xB3 0x32
		0x39 0x01 0x00 0x00 0x00 0x00 0x06 0xB6 0x32 0x31 0x31 0x13 0x13
		0x39 0x01 0x00 0x00 0x00 0x00 0x06 0xB7 0x12 0x12 0x32 0x00 0x00
		0x39 0x01 0x00 0x00 0x00 0x00 0x06 0xB8 0x0F 0x0F 0x0E 0x0E 0x32
		0x15 0x01 0x00 0x00 0x00 0x00 0x02 0xB9 0x32
		0x39 0x01 0x00 0x00 0x00 0x00 0x06 0xF0 0x55 0xAA 0x52 0x08 0x07
		0x39 0x01 0x00 0x00 0x00 0x00 0x07 0xB1 0x00 0x10 0x00 0x10 0x00 0x00
		0x05 0x01 0x00 0x00 0x50 0x01 0x01 0x11
		0x15 0x01 0x00 0x00 0x00 0x00 0x02 0x2F 0x01
		0x05 0x01 0x00 0x00 0x00 0x00 0x01 0x29
		0x15 0x01 0x00 0x00 0x00 0x00 0x02 0x2F 0x02
		0x39 0x01 0x00 0x00 0x00 0x00 0x06 0xF0 0x55 0xAA 0x52 0x08 0x02
		0x15 0x01 0x00 0x00 0x00 0x00 0x02 0xBF 0x44
		0x39 0x01 0x00 0x00 0x00 0x00 0x19 0xB0 0x00 0x00 0x00 0x00 0x00 0x00 0x00 0x00 0x00 0x00 0x00 0x00 0x00 0x00 0x00 0x00 0x00 0x00 0x00 0x00 0x00 0x00 0x00 0x00
		0x39 0x01 0x00 0x00 0x00 0x00 0x19 0xB1 0x00 0x00 0x00 0x00 0x00 0x00 0x00 0x00 0x00 0x00 0x00 0x00 0x00 0x00 0x0F 0xFF 0x0F 0xFF 0x0F 0xFF 0x0F 0xFF 0x0F 0xFF
		0x39 0x01 0x00 0x00 0x00 0x00 0x17 0xB2 0x0F 0xFF 0x0F 0xFF 0x0F 0xFF 0x0F 0xFF 0x0F 0xFF 0x0F 0xFF 0x0F 0xFF 0x0F 0xFF 0x0F 0xFF 0x0F 0xFF 0x0F 0xFF
		0x39 0x01 0x00 0x00 0x00 0x00 0x19 0xB3 0x00 0x00 0x00 0x00 0x00 0x00 0x00 0x00 0x00 0x00 0x00 0x00 0x00 0x00 0x00 0x00 0x00 0x00 0x00 0x00 0x00 0x00 0x00 0x00
		0x39 0x01 0x00 0x00 0x00 0x00 0x19 0xB4 0x00 0x00 0x00 0x00 0x00 0x00 0x00 0x00 0x00 0x00 0x00 0x00 0x00 0x00 0x0F 0xFF 0x0F 0xFF 0x0F 0xFF 0x0F 0xFF 0x0F 0xFF
		0x39 0x01 0x00 0x00 0x00 0x00 0x17 0xB5 0x0F 0xFF 0x0F 0xFF 0x0F 0xFF 0x0F 0xFF 0x0F 0xFF 0x0F 0xFF 0x0F 0xFF 0x0F 0xFF 0x0F 0xFF 0x0F 0xFF 0x0F 0xFF
		0x39 0x01 0x00 0x00 0x00 0x00 0x19 0xB6 0x00 0x00 0x00 0x00 0x00 0x00 0x00 0x00 0x00 0x00 0x00 0x00 0x00 0x00 0x00 0x00 0x00 0x00 0x00 0x00 0x00 0x00 0x00 0x00
		0x39 0x01 0x00 0x00 0x00 0x00 0x19 0xB7 0x00 0x00 0x00 0x00 0x00 0x00 0x00 0x00 0x00 0x00 0x00 0x00 0x00 0x00 0x0F 0xFF 0x0F 0xFF 0x0F 0xFF 0x0F 0xFF 0x0F 0xFF
		0x39 0x01 0x00 0x00 0x00 0x00 0x17 0xB8 0x0F 0xFF 0x0F 0xFF 0x0F 0xFF 0x0F 0xFF 0x0F 0xFF 0x0F 0xFF 0x0F 0xFF 0x0F 0xFF 0x0F 0xFF 0x0F 0xFF 0x0F 0xFF>;
		lcd-kit,vtc-line-cmds-state  = "dsi_lp_mode";
		lcd-kit,ap-aod-support = <1>;
		lcd-kit,doze-time-delay = <1000>;
		lcd-kit,left-time-to-te-us = <27667>;
		lcd-kit,right-time-to-te-us = <29667>;
		lcd-kit,te-interval-time-us = <16667>;
		lcd-kit,color-aod-detect-support = <1>;
		lcd-kit,check-reg-on-support = <0>;
		lcd-kit,check-reg-on-support-dsm-report = <0>;
		lcd-kit,check-aod-reg-on-support = <0>;
		lcd-kit,check-aod-reg-on-support-dsm-report = <0>;
		lcd-kit,check-reg-off-support = <0>;
		lcd-kit,check-reg-off-support-dsm-report = <0>;
		lcd-kit,checksum-support = <1>;
		lcd-kit,pcd-cmds-support = <1>;
		lcd-kit,pcd-check-reg-value-compare-mode = <1>;
		lcd-kit,vtc-line-support = <1>;
		lcd-kit,vtc-line-no-reset = <1>;
		qcom,mdss-dsi-panel-type = "dsi_cmd_mode";
		qcom,mdss-pan-physical-width-dimension = <68>;
		qcom,mdss-pan-physical-height-dimension = <160>;
		qcom,dsi-ctrl-num = <0>;
		qcom,dsi-phy-num = <0>;
		qcom,panel-supply-entries = <&dsi_panel_pwr_supply>;
		qcom,mdss-dsi-virtual-channel-id = <0>;
		qcom,mdss-dsi-h-sync-pulse = <0>;
		qcom,mdss-dsi-bllp-eof-power-mode;
		qcom,mdss-dsi-bllp-power-mode;
		qcom,mdss-dsi-dma-schedule-line = <1>;
		qcom,mdss-dsi-bpp = <24>;
		qcom,mdss-dsi-color-order = "rgb_swap_rgb";
		qcom,mdss-dsi-underflow-color = <0xff>;
		qcom,mdss-dsi-border-color = <0>;
		qcom,mdss-dsi-traffic-mode = "burst_mode";
		qcom,mdss-dsi-lane-map = "lane_map_0123";
		qcom,mdss-dsi-lane-0-state;
		qcom,mdss-dsi-lane-1-state;
		qcom,mdss-dsi-lane-2-state;
		qcom,mdss-dsi-lane-3-state;
		qcom,mdss-dsi-mdp-trigger = "none";
		qcom,mdss-dsi-dma-trigger = "trigger_sw";
		qcom,mdss-dsi-te-pin-select = <1>;
		qcom,mdss-dsi-wr-mem-start = <0x2c>;
		qcom,mdss-dsi-wr-mem-continue = <0x3c>;
		qcom,mdss-dsi-te-dcs-command = <1>;
		qcom,mdss-dsi-te-check-enable;
		qcom,mdss-dsi-te-using-te-pin;
		qcom,dsi-panel-gpio-address = <0x0F100000 0x1000>;
		qcom,dsi-panel-gpio-pins = <12 24 82>;
		qcom,dsi-panel-gpio-names = "reg-gpio", "reset-gpio", "platform-te-gpio";
		qcom,mdss-dsi-t-clk-post = <0>;
		qcom,mdss-dsi-t-clk-pre = <0>;
		qcom,dsi-select-clocks = "mux_byte_clk0", "mux_pixel_clk0";
		qcom,mdss-dsi-stream = <0>;
		qcom,mdss-dsi-lp11-init;
		qcom,sublinks-count = <2>;
		qcom,lanes-per-sublink = <2>;
		qcom,mdss-dsi-panel-hdr-color-primaries = <14500 15500 32000 17000 15500 30000 8000 3000>;
		qcom,mdss-dsi-panel-peak-brightness = <4200000>;
		qcom,mdss-dsi-panel-blackness-level = <3230>;
		qcom,dynamic-mode-switch-type = "dynamic-resolution-switch-immediate";
		qcom,mdss-dsi-bl-pmic-control-type = "bl_ctrl_dcs";
		qcom,mdss-dsi-bl-min-level = <1>;
		qcom,mdss-dsi-bl-max-level = <4095>;
		lcd-kit,power-on-stage = <2 1 1
				9 1 1
				3 1 1
				1 1 10
				5 1 10
				7 1 0
				6 1 0
				8 1 0>;
		lcd-kit,lp-on-stage = <0 0 0>;
		lcd-kit,lp-off-stage = <0 0 0>;
		lcd-kit,power-off-stage = <7 0 0
				6 0 0
				8 0 0
				5 0 1
				1 0 1
				9 0 1
				3 0 1
				2 0 1>;
		lcd-kit,only-power-off-stage = <0 0 0>;
		lcd-kit,pt-support = <1>;
		lcd-kit,panel-on-always-reset = <0>;
		lcd-kit,lcd-vci = <1 13 3000000 3000000 3000000 10000 80>;
		lcd-kit,lcd-iovcc = <1 12 1800000 1800000 1800000 60700 80>;
		lcd-kit,lcd-vdd = <2 49 1200000>;
		lcd-kit,lcd-vsp = <1 1 1200000 1200000 1200000 60700 80>;
		lcd-kit,lcd-reset = <2 24 0>;
		lcd-kit,lcd-vci-name = "vdd";
		lcd-kit,lcd-iovcc-name = "vddio";
		lcd-kit,lcd-vsp-name = "ddic";
		lcd-kit,project-id-support = <0>;
		lcd-kit,default-project-id = "G21579250";
		lcd-kit,sn-code-support = <1>;
		lcd-kit,oem-info-support = <1>;
		lcd-kit,oem-barcode-2d-support = <1>;
		lcd-kit,oem-barcode-2d-num-offset = <0>;
		lcd-kit,barcode-2d-cmds = <0x39 0x01 0x00 0x00 0x0a 0x00 0x06 0xF0 0x55 0xAA 0x52 0x08 0x01
			0x14 0x01 0x00 0x00 0x0a 0x00 0x08 0xD6 0x00 0x00 0x00 0x00 0x00 0x00 0x00
			0x14 0x01 0x00 0x00 0x0a 0x00 0x06 0xBF 0x00 0x00 0x00 0x00 0x00
			0x14 0x01 0x00 0x00 0x0a 0x00 0x07 0xD7 0x00 0x00 0x00 0x00 0x00 0x00>;
		lcd-kit,barcode-2d-cmds-state = "dsi_lp_mode";
		lcd-kit,panel-getblmaxnit-type = <0>;
		lcd-kit,panel-blmaxnit-min-value = <400>;
		lcd-kit,inversion-support = <0>;
		lcd-kit,panel-gpio-offset = <308>;
		lcd-kit,finger-unlock-state-support = <0>;
		lcd-kit,panel-bl-max-nit = <450>;
		lcd-kit,panel-bl-min = <4>;
		lcd-kit,panel-bl-max = <4095>;
		lcd-kit,panel-bl-def = <2047>;
		lcd-kit,check-reg-support = <0>;
		lcd-kit,thp-proximity-support = <0>;
		lcd-kit,proximity-reset-delay-min = <65>;
		lcd-kit,backlight-cmds = <0x39 0x01 0x00 0x00 0x00 0x00 0x03 0x51 0x00 0x00>;
		lcd-kit,backlight-cmds-state = "dsi_lp_mode";
		lcd-kit,backlight-order = <0>;
		lcd-kit,backlight-need-sync = <0>;
		lcd-kit,fps-support = <1>;
		lcd-kit,default-fps = <60>;
		lcd-kit,panel-support-fps-list = <60 90>;
		qcom,mdss-dsi-display-timings {
			timing@0 {
				qcom,mdss-dsi-panel-width = <1188>;
				qcom,mdss-dsi-panel-height = <2790>;
				qcom,mdss-dsi-h-front-porch = <32>;
				qcom,mdss-dsi-h-back-porch = <32>;
				qcom,mdss-dsi-h-pulse-width = <32>;
				qcom,mdss-dsi-h-sync-skew = <0>;
				qcom,mdss-dsi-v-front-porch = <16>;
				qcom,mdss-dsi-v-back-porch = <12>;
				qcom,mdss-dsi-v-pulse-width = <4>;
				qcom,mdss-dsi-panel-framerate = <60>;
				qcom,mdss-dsi-panel-phy-timings= [00 13 04 04 13 1E 05
			05 05 04 02 04 10 09];
				qcom,display-topology  = <1 1 1>;
				qcom,default-topology-index  = <0>;
				qcom,mdss-dsi-on-command = [39 01 00 00 00 00 06 F0 55 AA 52 00 00
			39 01 00 00 00 00 05 FF AA 55 A5 80
			15 01 00 00 00 00 02 6F 1D
			15 01 00 00 00 00 02 F2 05
			39 01 00 00 00 00 05 FF AA 55 A5 81
			39 01 00 00 00 00 05 FF AA 55 A5 00
			05 01 00 00 00 00 01 35
			15 01 00 00 00 00 02 53 20
			39 01 00 00 00 00 05 51 00 00 00 00
			39 01 00 00 00 00 05 2A 00 00 04 A3
			39 01 00 00 00 00 05 2B 00 00 0A E5
			15 01 00 00 00 00 02 82 A8
			15 01 00 00 00 00 02 03 01
			15 01 00 00 00 00 02 90 01
			39 01 00 00 00 00 13 91 89 28 00 1E C2 00 03 52 03 FC 00 10 03 50 01 8B 10 F0
			05 01 00 00 00 00 01 2C
			15 01 00 00 00 00 02 2F 01
			39 01 00 00 00 00 06 F0 55 AA 52 08 00
			39 01 00 00 00 00 0F C5 55 55 55 55 00 05 00 55 55 55 55 55 55 55
			39 01 00 00 00 00 06 F0 55 AA 52 08 00
			15 01 00 00 00 00 02 6F 05
			39 01 00 00 00 00 06 B5 7F 4E 1C 4F 54
			15 01 00 00 00 00 02 6F 0B
			39 01 00 00 00 00 05 B5 4E 25 50 54
			15 01 00 00 00 00 02 6F 10
			39 01 00 00 00 00 06 B5 1C 1C 1C 1C 1C
			39 01 00 00 00 00 06 F0 55 AA 52 08 00
			15 01 00 00 00 00 02 6F 08
			15 01 00 00 00 00 02 B5 50
			15 01 00 00 00 00 02 6F 0D
			15 01 00 00 00 00 02 B5 50
			39 01 00 00 00 00 06 F0 55 AA 52 08 07
			15 01 00 00 00 00 02 C0 00
			05 01 00 00 50 00 01 11
			05 01 00 00 00 00 01 29];
				qcom,mdss-dsi-on-command-state = "dsi_lp_mode";
				qcom,mdss-dsi-off-command = [39 01 00 00 00 00 06 F0 55 AA 52 08 00
			15 01 00 00 00 00 02 6F 0D
			15 01 00 00 00 00 02 B5 50
			15 01 00 00 22 00 02 65 00
			05 01 00 00 00 00 01 38
			05 01 00 00 00 00 01 2C
			05 01 00 00 00 00 01 28
			05 01 00 00 50 00 01 10];
				qcom,mdss-dsi-off-command-state = "dsi_lp_mode";
				qcom,compression-mode = "dsc";
				qcom,mdss-dsc-slice-height = <30>;
				qcom,mdss-dsc-slice-width = <1188>;
				qcom,mdss-dsc-slice-per-pkt = <1>;
				qcom,mdss-dsc-bit-per-component = <8>;
				qcom,mdss-dsc-bit-per-pixel = <8>;
				qcom,mdss-dsc-block-prediction-enable;
			};
		};
    };
};