#include "../../common/common.dtsi"
#include "huawei_audio.dtsi"
#include "huawei-lcd.dtsi"
#include "huawei_tp.dtsi"
#include "huawei_bsp.dtsi"
#include "huawei_fp.dtsi"
#include "huawei_charger.dtsi"
#include "huawei_ir.dtsi"
#include "huawei-sensor.dtsi"
#include "huawei_fac.dtsi"
#include "huawei_mmc.dtsi"
#include "huawei_usb.dtsi"
#include "huawei_dp.dtsi"