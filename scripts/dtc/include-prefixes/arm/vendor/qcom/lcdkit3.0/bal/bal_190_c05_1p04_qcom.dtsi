/* Copyright (c) 2013, The Linux Foundation. All rights reserved.
 *
 * This program is free software; you can redistribute it and/or modify
 * it under the terms of the GNU General Public License version 2 and
 * only version 2 as published by the Free Software Foundation.
 *
 * This program is distributed in the hope that it will be useful,
 * but WITHOUT ANY WARRANTY; without even the implied warranty of
 * MERCHANTABILITY or FITNESS FOR A PARTICULAR PURPOSE.  See the
 * GNU General Public License for more details.
 */

/*-------------------------------------------------------------------------
 * This file is autogenerated file using gcdb parser. Please do not edit it.
 * Update input XML file to add a new entry or update variable in this file
 * VERSION = 1.1
 *-----------------------------------------------------------------------*/
&mdss_mdp {
	dsi_bal_190_c05_1p04_qcom: lcd_kit_bal_190_c05_1p04_qcom {
		compatible = "190_c05_1p04";
		lcd-kit,panel-name = "190_c05 1.04' 340 x 340";
		lcd-kit,panel-type = <0x02>;
		lcd-kit,panel-aod-high-brightness-cmds = <0x15 0x01 0x00 0x00 0x00 0x00 0x02 0x51 0xFF>;
		lcd-kit,panel-aod-low-brightness-cmds = <0x15 0x01 0x00 0x00 0x00 0x00 0x02 0x51 0x52>;
		lcd-kit,panel-aod-no-brightness-cmds = <0x15 0x01 0x00 0x00 0x00 0x00 0x02 0x51 0x00>;
		lcd-kit,panel-aod-middle-brightness-cmds = <0x15 0x01 0x00 0x00 0x00 0x00 0x02 0x51 0x87>;
		lcd-kit,check-reg-on-cmds = <0x06 0x01 0x00 0x00 0x0a 0x00 0x01 0x0a>;
		lcd-kit,check-reg-on-value = <0x9c>;
		lcd-kit,check-aod-reg-on-cmds = <0x06 0x01 0x00 0x00 0x0a 0x00 0x01 0x0a>;
		lcd-kit,check-aod-reg-on-value = <0xdc>;
		lcd-kit,check-reg-off-cmds = <0x06 0x01 0x00 0x00 0x0a 0x00 0x01 0x0a>;
		lcd-kit,check-reg-off-value = <0x08>;
		lcd-kit,check-reg-on-cmds-state = "dsi_lp_mode";
		lcd-kit,check-aod-reg-on-cmds-state = "dsi_lp_mode";
		lcd-kit,check-reg-off-cmds-state = "dsi_lp_mode";
		lcd-kit,fpc-detect-support = <1>;
		lcd-kit,fpc-detect-pinctrl-cfg = <1>;
		lcd-kit,fpc-det-gpio-list = <315 463>;
		lcd-kit,fpc-exp-gpio-val-list = <0 0>;
		lcd-kit,color-aod-detect-enter = <0x15 0x01 0x00 0x00 0x00 0x00 0x02 0xFE 0x00
		0x05 0x01 0x00 0x00 0x00 0x00 0x01 0x39
		0x15 0x01 0x00 0x00 0x00 0x00 0x02 0x51 0xFF>;
		lcd-kit,color-aod-detect-enter-state = "dsi_lp_mode";
		lcd-kit,color-aod-detect-exit = <0x15 0x01 0x00 0x00 0x00 0x00 0x02 0xFE 0x00
		0x05 0x01 0x00 0x00 0x00 0x00 0x01 0x38>;
		lcd-kit,color-aod-detect-exit-state = "dsi_lp_mode";
		lcd-kit,ap-aod-support = <1>;
		lcd-kit,doze-time-delay = <1000>;
		lcd-kit,color-aod-detect-support = <1>;
		lcd-kit,check-reg-on-support = <0>;
		lcd-kit,check-reg-on-support-dsm-report = <0>;
		lcd-kit,check-aod-reg-on-support = <0>;
		lcd-kit,check-aod-reg-on-support-dsm-report = <0>;
		lcd-kit,check-reg-off-support = <0>;
		lcd-kit,check-reg-off-support-dsm-report = <0>;
		qcom,mdss-dsi-panel-type = "dsi_cmd_mode";
		qcom,mdss-pan-physical-width-dimension = <26>;
		qcom,mdss-pan-physical-height-dimension = <26>;
		qcom,dsi-ctrl-num = <1>;
		qcom,dsi-phy-num = <1>;
		qcom,panel-supply-entries = <&dsi_panel_pwr_supply>;
		qcom,mdss-dsi-virtual-channel-id = <0>;
		qcom,mdss-dsi-h-sync-pulse = <0>;
		qcom,mdss-dsi-bllp-eof-power-mode;
		qcom,mdss-dsi-bllp-power-mode;
		qcom,mdss-dsi-dma-schedule-line = <1>;
		qcom,mdss-dsi-bpp = <24>;
		qcom,mdss-dsi-color-order = "rgb_swap_rgb";
		qcom,mdss-dsi-underflow-color = <0xff>;
		qcom,mdss-dsi-border-color = <0>;
		qcom,mdss-dsi-traffic-mode = "burst_mode";
		qcom,mdss-dsi-lane-map = "lane_map_0123";
		qcom,mdss-dsi-lane-0-state;
		qcom,mdss-dsi-mdp-trigger = "none";
		qcom,mdss-dsi-dma-trigger = "trigger_sw";
		qcom,mdss-dsi-te-pin-select = <0>;
		qcom,mdss-dsi-t-clk-post = <0>;
		qcom,mdss-dsi-t-clk-pre = <0>;
		qcom,dsi-select-clocks = "mux_byte_clk1", "mux_pixel_clk1";
		qcom,mdss-dsi-stream = <0>;
		qcom,mdss-dsi-lp11-init;
		qcom,sublinks-count = <2>;
		qcom,lanes-per-sublink = <2>;
		qcom,mdss-dsi-panel-hdr-color-primaries = <14500 15500 32000 17000 15500 30000 8000 3000>;
		qcom,mdss-dsi-panel-peak-brightness = <4200000>;
		qcom,mdss-dsi-panel-blackness-level = <3230>;
		qcom,dynamic-mode-switch-type = "dynamic-resolution-switch-immediate";
		qcom,mdss-dsi-bl-pmic-control-type = "bl_ctrl_dcs";
		qcom,mdss-dsi-bl-min-level = <1>;
		qcom,mdss-dsi-bl-max-level = <255>;
		lcd-kit,power-on-stage = <2 1 1
				1 1 10
				5 1 1
				5 0 1
				5 1 10
				7 1 0
				6 1 0
				8 1 0>;
		lcd-kit,lp-on-stage = <0 0 0>;
		lcd-kit,lp-off-stage = <0 0 0>;
		lcd-kit,power-off-stage = <7 0 0
				6 0 0
				8 0 0
				5 0 1
				1 0 12
				2 0 1>;
		lcd-kit,only-power-off-stage = <0 0 0>;
		lcd-kit,pt-support = <1>;
		lcd-kit,panel-on-always-reset = <0>;
		lcd-kit,lcd-vci = <2 76 0>;
		lcd-kit,lcd-iovcc = <2 77 0>;
		lcd-kit,lcd-vdd = <2 197 1200000>;
		lcd-kit,lcd-reset = <2 6 0>;
		lcd-kit,project-id-support = <0>;
		lcd-kit,default-project-id = "G21579250";
		lcd-kit,sn-code-support = <1>;
		lcd-kit,oem-info-support = <1>;
		lcd-kit,oem-barcode-2d-support = <1>;
		lcd-kit,oem-barcode-2d-num-offset = <0>;
		lcd-kit,barcode-2d-cmds = <0x15 0x01 0x00 0x00 0x0a 0x00 0x02 0xFE 0x0B
			0x06 0x01 0x00 0x00 0x0a 0x00 0x01 0x00
			0x06 0x01 0x00 0x00 0x0a 0x00 0x01 0x01
			0x06 0x01 0x00 0x00 0x0a 0x00 0x01 0x02
			0x06 0x01 0x00 0x00 0x0a 0x00 0x01 0x03
			0x06 0x01 0x00 0x00 0x0a 0x00 0x01 0x04
			0x06 0x01 0x00 0x00 0x0a 0x00 0x01 0x05
			0x06 0x01 0x00 0x00 0x0a 0x00 0x01 0x06
			0x06 0x01 0x00 0x00 0x0a 0x00 0x01 0x07
			0x06 0x01 0x00 0x00 0x0a 0x00 0x01 0x08
			0x06 0x01 0x00 0x00 0x0a 0x00 0x01 0x09
			0x06 0x01 0x00 0x00 0x0a 0x00 0x01 0x0A
			0x06 0x01 0x00 0x00 0x0a 0x00 0x01 0x0B
			0x06 0x01 0x00 0x00 0x0a 0x00 0x01 0x0C
			0x06 0x01 0x00 0x00 0x0a 0x00 0x01 0x0D
			0x06 0x01 0x00 0x00 0x0a 0x00 0x01 0x0E
			0x06 0x01 0x00 0x00 0x0a 0x00 0x01 0x0F
			0x06 0x01 0x00 0x00 0x0a 0x00 0x01 0x10
			0x06 0x01 0x00 0x00 0x0a 0x00 0x01 0x11
			0x06 0x01 0x00 0x00 0x0a 0x00 0x01 0x12
			0x06 0x01 0x00 0x00 0x0a 0x00 0x01 0x13
			0x06 0x01 0x00 0x00 0x0a 0x00 0x01 0x14
			0x15 0x01 0x00 0x00 0x0a 0x00 0x02 0xFE 0x00>;
		lcd-kit,barcode-2d-cmds-state = "dsi_lp_mode";
		lcd-kit,panel-getblmaxnit-type = <0>;
		lcd-kit,panel-blmaxnit-min-value = <400>;
		lcd-kit,inversion-support = <0>;
		lcd-kit,panel-gpio-offset = <308>;
		lcd-kit,finger-unlock-state-support = <0>;
		lcd-kit,panel-bl-max-nit = <450>;
		lcd-kit,panel-bl-min = <4>;
		lcd-kit,panel-bl-max = <255>;
		lcd-kit,panel-bl-def = <127>;
		lcd-kit,check-reg-support = <0>;
		lcd-kit,thp-proximity-support = <0>;
		lcd-kit,proximity-reset-delay-min = <65>;
		lcd-kit,backlight-cmds = <0x15 0x01 0x00 0x00 0x00 0x00 0x02 0x51 0x00>;
		lcd-kit,backlight-cmds-state = "dsi_lp_mode";
		lcd-kit,backlight-order = <0>;
		lcd-kit,backlight-need-sync = <0>;
		qcom,mdss-dsi-display-timings {
			timing@0 {
				qcom,mdss-dsi-panel-width = <340>;
				qcom,mdss-dsi-panel-height = <340>;
				qcom,mdss-dsi-h-front-porch = <16>;
				qcom,mdss-dsi-h-back-porch = <16>;
				qcom,mdss-dsi-h-pulse-width = <16>;
				qcom,mdss-dsi-h-sync-skew = <0>;
				qcom,mdss-dsi-v-front-porch = <16>;
				qcom,mdss-dsi-v-back-porch = <12>;
				qcom,mdss-dsi-v-pulse-width = <4>;
				qcom,mdss-dsi-panel-framerate = <60>;
				qcom,mdss-dsi-panel-phy-timings= [00 0A 02 02 0F 1D 02
			02 02 02 02 04 0A 07];
				qcom,display-topology  = <1 0 1>;
				qcom,default-topology-index  = <0>;
				qcom,mdss-dsi-on-command = [15 01 00 00 00 00 02 FE 00
			15 01 00 00 00 00 02 35 02
			15 01 00 00 00 00 02 53 20
			15 01 00 00 00 00 02 63 FF
			39 01 00 00 00 00 05 2A 00 0A 01 5D
			39 01 00 00 00 00 05 2B 00 00 01 53
			05 01 00 00 50 00 01 11
			05 01 00 00 00 00 01 29];
				qcom,mdss-dsi-on-command-state = "dsi_lp_mode";
				qcom,mdss-dsi-off-command = [05 01 00 00 00 00 01 28
			05 01 00 00 55 00 01 10];
				qcom,mdss-dsi-off-command-state = "dsi_lp_mode";
			};
		};
    };
};