/*---------------------------------------------------------------------------
 * This file is autogenerated file using huawei LCD parser. Please do not edit it.
 * Update input XML file to add a new entry or update variable in this file
 * Parser location: vendor/huawei/chipset_common/devkit/lcdkit/tools 
 *---------------------------------------------------------------------------*/


#include "rna_110_207_6p72_qcom.dtsi"
#include "rna_190_207_6p72_qcom.dtsi"
#include "rna_310_207_6p72_qcom.dtsi"
#include "rna_310_e00_6p72_qcom.dtsi"
#include "rna_auo_otm1901a_5p2_1080p_video_default.dtsi"