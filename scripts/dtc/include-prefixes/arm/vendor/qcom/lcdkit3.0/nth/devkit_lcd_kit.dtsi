/*---------------------------------------------------------------------------
 * This file is autogenerated file using huawei LCD parser. Please do not edit it.
 * Update input XML file to add a new entry or update variable in this file
 * Parser location: vendor/huawei/chipset_common/devkit/lcdkit/tools 
 *---------------------------------------------------------------------------*/


#include "nth_190_207_6p57_qcom.dtsi"
#include "nth_190_801_6p57_qcom.dtsi"
#include "nth_190_c06_6p57_qcom.dtsi"
#include "nth_290_207_6p57_qcom.dtsi"
#include "nth_310_207_1_6p57_qcom.dtsi"
#include "nth_310_207_6p57_qcom.dtsi"
#include "nth_310_c06_6p57_qcom.dtsi"
#include "nth_auo_otm1901a_5p2_1080p_video_default.dtsi"