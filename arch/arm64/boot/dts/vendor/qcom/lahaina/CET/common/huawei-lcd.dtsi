#include "../../../lcdkit3.0/cet/devkit_lcd_kit.dtsi"
&huawei_lcd_panel {
	compatible = "huawei,lcd_panel_type";
	/* auto_key_info @ name: product_id type: uint32 default: 0 */
	product_id = <7000>;
	detect_type = <2>;
	/* auto_key_info @ name: gpio_id[2] type: int default: 0 */
	gpio_id = <28 29>;
	support_lcd_type = "LCD_KIT";
};

&sde_dsi {
	qcom,dsi-default-panel = <&dsi_cet_auo_otm1901a_5p2_1080p_video_default>;
};