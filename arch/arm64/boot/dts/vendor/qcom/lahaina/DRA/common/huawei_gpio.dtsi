&qupv3_se0_i2c {
	extgpio: pca6416-gpio@21 {
		compatible = "ti,tca6416";
		reg = <0x21>;
		gpio-controller;
		#gpio-cells = <2>;
		interrupts = <91 IRQ_TYPE_LEVEL_LOW>; /* GPIO_091 */
		interrupt-parent = <&tlmm>;
		interrupt-controller;
		init_gpio = <1 1 1 1 1 1 1 1 1 1 1 1 1 1 1 1>; /* 0:DI 1:DOL 2:DOH */
		status = "ok";
	};
};