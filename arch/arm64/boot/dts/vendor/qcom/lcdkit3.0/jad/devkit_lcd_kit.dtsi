/*---------------------------------------------------------------------------
 * This file is autogenerated file using huawei LCD parser. Please do not edit it.
 * Update input XML file to add a new entry or update variable in this file
 * Parser location: vendor/huawei/chipset_common/devkit/lcdkit/tools 
 *---------------------------------------------------------------------------*/


#include "jad_100_707_6p59_qcom.dtsi"
#include "jad_190_207_6p59_qcom.dtsi"
#include "jad_auo_otm1901a_5p2_1080p_video_default.dtsi"