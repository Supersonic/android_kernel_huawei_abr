/* Copyright (c) 2013, The Linux Foundation. All rights reserved.
 *
 * This program is free software; you can redistribute it and/or modify
 * it under the terms of the GNU General Public License version 2 and
 * only version 2 as published by the Free Software Foundation.
 *
 * This program is distributed in the hope that it will be useful,
 * but WITHOUT ANY WARRANTY; without even the implied warranty of
 * MERCHANTABILITY or FITNESS FOR A PARTICULAR PURPOSE.  See the
 * GNU General Public License for more details.
 */

/*-------------------------------------------------------------------------
 * This file is autogenerated file using gcdb parser. Please do not edit it.
 * Update input XML file to add a new entry or update variable in this file
 * VERSION = 1.1
 *-----------------------------------------------------------------------*/
&mdss_mdp {
	dsi_bah4_190_502_10p3_qcom: lcd_kit_bah4_190_502_10p3_qcom {
		compatible = "190_502_10p3";
		lcd-kit,panel-name = "BAH4_190 502 0 10.3' 1200 x 2000";
		lcd-kit,panel-type = <0x01>;
		lcd-kit,panel-xres = <1200>;
		lcd-kit,panel-yres = <2000>;
		lcd-kit,check-reg-on-cmds = <0x06 0x01 0x00 0x00 0x0a 0x00 0x01 0x0a>;
		lcd-kit,check-reg-on-value = <0x9c>;
		lcd-kit,check-aod-reg-on-cmds = <0x06 0x01 0x00 0x00 0x0a 0x00 0x01 0x0a>;
		lcd-kit,check-aod-reg-on-value = <0xdc>;
		lcd-kit,check-reg-off-cmds = <0x06 0x01 0x00 0x00 0x0a 0x00 0x01 0x0a>;
		lcd-kit,check-reg-off-value = <0x08>;
		lcd-kit,check-reg-on-cmds-state = "dsi_lp_mode";
		lcd-kit,check-aod-reg-on-cmds-state = "dsi_lp_mode";
		lcd-kit,check-reg-off-cmds-state = "dsi_lp_mode";
		lcd-kit,check-reg-on-support = <0>;
		lcd-kit,check-reg-on-support-dsm-report = <0>;
		lcd-kit,check-aod-reg-on-support = <0>;
		lcd-kit,check-aod-reg-on-support-dsm-report = <0>;
		lcd-kit,check-reg-off-support = <0>;
		lcd-kit,check-reg-off-support-dsm-report = <0>;
		qcom,mdss-dsi-panel-type = "dsi_video_mode";
		qcom,mdss-pan-physical-width-dimension = <136>;
		qcom,mdss-pan-physical-height-dimension = <226>;
		qcom,dsi-ctrl-num = <0>;
		qcom,dsi-phy-num = <0>;
		qcom,panel-supply-entries = <&dsi_panel_pwr_supply>;
		qcom,mdss-dsi-virtual-channel-id = <0>;
		qcom,mdss-dsi-h-sync-pulse = <0>;
		qcom,mdss-dsi-bllp-eof-power-mode;
		qcom,mdss-dsi-bllp-power-mode;
		qcom,mdss-dsi-dma-schedule-line = <1>;
		qcom,mdss-dsi-bpp = <24>;
		qcom,mdss-dsi-color-order = "rgb_swap_rgb";
		qcom,mdss-dsi-underflow-color = <0xff>;
		qcom,mdss-dsi-border-color = <0>;
		qcom,mdss-dsi-traffic-mode = "burst_mode";
		qcom,mdss-dsi-lane-map = "lane_map_0123";
		qcom,mdss-dsi-lane-0-state;
		qcom,mdss-dsi-lane-1-state;
		qcom,mdss-dsi-lane-2-state;
		qcom,mdss-dsi-lane-3-state;
		qcom,mdss-dsi-mdp-trigger = "none";
		qcom,mdss-dsi-dma-trigger = "trigger_sw";
		qcom,mdss-dsi-te-pin-select = <0>;
		qcom,mdss-dsi-t-clk-post = <0x0D>;
		qcom,mdss-dsi-t-clk-pre = <0x1B>;
		qcom,dsi-select-clocks = "mux_byte_clk0", "mux_pixel_clk0";
		qcom,mdss-dsi-stream = <0>;
		qcom,mdss-dsi-lp11-init;
		qcom,sublinks-count = <2>;
		qcom,lanes-per-sublink = <2>;
		qcom,mdss-dsi-panel-hdr-color-primaries = <14500 15500 32000 17000 15500 30000 8000 3000>;
		qcom,mdss-dsi-panel-peak-brightness = <4200000>;
		qcom,mdss-dsi-panel-blackness-level = <3230>;
		qcom,dynamic-mode-switch-type = "dynamic-resolution-switch-immediate";
		qcom,mdss-dsi-bl-pmic-control-type = "bl_ctrl_i2c_ic";
		qcom,esd-check-enabled;
		qcom,tp-esd-gpio-event;
		qcom,mdss-dsi-panel-status-command = [14 01 00 00 00 00 01 0A
			06 01 00 00 00 00 04 09 00 00 00
			14 01 00 00 00 00 01 45];
		qcom,mdss-dsi-panel-status-command-state = "dsi_lp_mode";
		qcom,mdss-dsi-panel-status-check-mode = "reg_read";
		qcom,mdss-dsi-panel-status-read-length = <1 4 1>;
		qcom,mdss-dsi-panel-status-value = <0x9D>,<0x80 0x73 0x04 0x00>,<0x08>;
		lcd-kit,power-on-stage = <2 1 2
				7 1 1
				3 1 5
				4 1 5
				11 1 1
				5 1 2
				5 2 2
				5 1 55
				6 1 0
				8 1 0>;
		lcd-kit,lp-on-stage = <0 0 0>;
		lcd-kit,lp-off-stage = <0 0 0>;
		lcd-kit,power-off-stage = <7 0 0
				6 0 0
				8 0 0
				5 0 2
				11 0 5
				4 0 2
				3 0 2
				2 0 0>;
		lcd-kit,pt-support = <0>;
		lcd-kit,panel-on-always-reset = <1>;
		lcd-kit,lcd-iovcc = <1 12 1900000 1900000 1900000 60700 80>;
		lcd-kit,lcd-vsp = <2 46 6000000>;
		lcd-kit,lcd-vsn = <2 62 6000000>;
		lcd-kit,lcd-reset = <2 44 0>;
		lcd-kit,lcd-iovcc-name = "vddio";
		lcd-kit,project-id-support = <1>;
		lcd-kit,default-project-id = "W1699L1300";
		lcd-kit,Does-lcd-poweron-tp = <1>;
		lcd-kit,sn-code-support = <0>;
		lcd-kit,oem-info-support = <0>;
		lcd-kit,oem-barcode-2d-support = <0>;
		lcd-kit,oem-barcode-2d-num-offset = <0>;
		lcd-kit,panel-getblmaxnit-type = <0>;
		lcd-kit,panel-blmaxnit-min-value = <400>;
		lcd-kit,inversion-support = <0>;
		lcd-kit,panel-gpio-offset = <336>;
		lcd-kit,finger-unlock-state-support = <0>;
		lcd-kit,panel-bl-max-nit = <450>;
		lcd-kit,panel-bl-min = <75>;
		lcd-kit,panel-bl-max = <3932>;
		lcd-kit,panel-bl-def = <128>;
		lcd-kit,check-reg-support = <0>;
		lcd-kit,thp-proximity-support = <0>;
		lcd-kit,proximity-reset-delay-min = <65>;
		lcd-kit,lcd-power-down-vsp = <2 46 4700000>;
		lcd-kit,lcd-power-down-vsn = <2 62 4700000>;
		lcd-kit,backlight-order = <0>;
		lcd-kit,backlight-need-sync = <0>;
		qcom,mdss-dsi-display-timings {
			timing@0 {
				qcom,mdss-dsi-panel-width = <1200>;
				qcom,mdss-dsi-panel-height = <2000>;
				qcom,mdss-dsi-h-front-porch = <40>;
				qcom,mdss-dsi-h-back-porch = <28>;
				qcom,mdss-dsi-h-pulse-width = <8>;
				qcom,mdss-dsi-h-sync-skew = <0>;
				qcom,mdss-dsi-v-front-porch = <44>;
				qcom,mdss-dsi-v-back-porch = <38>;
				qcom,mdss-dsi-v-pulse-width = <8>;
				qcom,mdss-dsi-panel-framerate = <60>;
				qcom,mdss-dsi-panel-phy-timings= [00 20 08 08 18 23 08
			08 08 02 04 00 1B 0D];
				qcom,display-topology  = <1 0 1>;
				qcom,default-topology-index  = <0>;
				qcom,mdss-dsi-on-command = [39 01 00 00 00 00 04 B9 83 10 2E
			15 01 00 00 00 00 02 E9 CD
			15 01 00 00 00 00 02 BB 01
			15 01 00 00 00 00 02 E9 00
			39 01 00 00 00 00 05 D1 67 2C FF 05
			39 01 00 00 00 00 04 BE 11 96 89
			39 01 00 00 00 00 04 D9 3F 03 04
			39 01 00 00 00 00 12 B1 10 FA AF AF 2B 2B A2 43 57 36 36 36 36 22 21 15 00
			39 01 00 00 00 00 11 B2 00 B0 47 D0 00 2C 2C 2C 00 00 00 00 15 20 D7 00
			39 01 00 00 00 00 11 B4 80 60 01 01 80 60 68 50 01 8E 01 58 00 FF 00 FF
			39 01 00 00 00 00 04 BF FC 85 80
			39 01 00 00 00 00 03 D2 2B 2B
			39 01 00 00 01 00 2C D3 00 00 00 00 01 04 00 08 08 27 27 22 2F 23 23 04 04 32 10 21 00 21 32 10 1F 00 02 32 17 FD 00 10 00 00 20 30 01 55 21 38 01 55 0F
			39 01 00 00 01 00 2F E0 00 06 10 18 20 39 51 59 61 5F 79 7F 86 95 92 98 A0 B3 B1 57 5F 6A 70 00 06 11 19 20 39 51 59 5F 5B 73 79 7C 89 86 8C 94 A5 A3 51 59 64 76
			15 01 00 00 00 00 02 BD 01
			39 01 00 00 00 00 05 B1 01 9B 01 31
			39 01 00 00 00 00 0B CB F4 36 12 16 C0 28 6C 85 3F 04
			39 01 00 00 00 00 0C D3 01 00 7C 00 00 11 10 00 0E 00 01
			15 01 00 00 00 00 02 BD 02
			39 01 00 00 01 00 07 B4 4E 00 33 11 33 88
			39 01 00 00 00 00 04 BF F2 00 02
			15 01 00 00 00 00 02 BD 00
			39 01 00 00 00 00 0F C0 23 23 22 11 A2 17 00 80 00 00 08 00 63 63
			15 01 00 00 00 00 02 C6 F9
			15 01 00 00 00 00 02 C7 30
			39 01 00 00 00 00 07 C8 00 04 04 00 00 82
			39 01 00 00 00 00 04 D0 07 04 05
			39 01 00 00 01 00 2D D5 03 02 01 00 07 06 05 04 18 18 24 24 19 19 18 18 19 19 21 20 23 22 18 18 18 18 18 18 18 18 18 18 18 18 18 18 18 18 18 18 18 18 18 18
			39 01 00 00 01 00 2D D6 04 05 06 07 00 01 02 03 18 18 24 24 19 19 19 19 18 18 22 23 20 21 18 18 18 18 18 18 18 18 18 18 18 18 18 18 18 18 18 18 18 18 18 18
			39 01 00 00 01 00 18 E7 12 13 02 02 47 00 0F 0F 00 1E 25 73 1E 73 01 27 00 00 00 00 17 00 68
			15 01 00 00 00 00 02 BD 01
			39 01 00 00 00 00 08 E7 02 34 01 88 0E BE 0F
			15 01 00 00 00 00 02 BD 02
			39 01 00 00 01 00 1D E7 FF 01 FD 01 00 00 22 00 00 00 00 00 00 00 00 00 00 00 00 00 00 00 00 00 81 01 02 40
			15 01 00 00 00 00 02 BD 00
			15 01 00 00 00 00 02 BD 02
			39 01 00 00 00 00 0D D8 FF FF FF FF FF F0 FF FF FF FF FF F0
			15 01 00 00 00 00 02 BD 03
			15 01 00 00 00 00 02 B2 80
			15 01 00 00 00 00 02 BD 00
			39 01 00 00 00 00 09 BA 70 03 A8 83 F2 00 00 0D
			15 01 00 00 00 00 02 CC 02
			39 01 00 00 00 00 03 E1 01 00
			15 01 00 00 00 00 02 BD 03
			39 01 00 00 00 00 19 D8 AA AA A8 00 00 00 AA AA A8 00 00 00 55 55 54 00 00 00 55 55 54 00 00 00
			15 01 00 00 00 00 02 BD 00
			05 01 00 00 78 00 01 11
			05 01 00 00 14 00 01 29];
				qcom,mdss-dsi-on-command-state = "dsi_lp_mode";
				qcom,mdss-dsi-off-command = [05 01 00 00 20 00 01 28
			05 01 00 00 78 00 01 10];
				qcom,mdss-dsi-off-command-state = "dsi_lp_mode";
			};
		};
    };
};