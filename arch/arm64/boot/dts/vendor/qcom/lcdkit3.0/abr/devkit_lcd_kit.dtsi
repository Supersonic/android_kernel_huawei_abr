/*---------------------------------------------------------------------------
 * This file is autogenerated file using huawei LCD parser. Please do not edit it.
 * Update input XML file to add a new entry or update variable in this file
 * Parser location: vendor/huawei/chipset_common/devkit/lcdkit/tools 
 *---------------------------------------------------------------------------*/


#include "abr_190_207_6p46_qcom.dtsi"
#include "abr_190_d01_6p46_qcom.dtsi"
#include "abr_auo_otm1901a_5p2_1080p_video_default.dtsi"