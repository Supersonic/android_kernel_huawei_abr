#include "lahaina-camera-sensor-jade-v3.dtsi"

&cam_cci1 {
	/* back mono sensor */
	qcom,cam-sensor1 {
		sensor-mixed-pin = <1>; /* DVDD GPIO6 -> pm8008i_l1 */
		cam_mixed1-supply = <&pm8008i_l1>; /* DVDD 1.136V */
		regulator-names = "cam_mixed1", "cam_vio", "cam_vana", "cam_vdig", "cam_vaf", "cam_clk";
		rgltr-min-voltage = <1136000 1800000 2850000 3140000 3200000 0>;
		rgltr-max-voltage = <1140000 1900000 2950000 3200000 3200000 0>;
		rgltr-load-current = <150000 74000 103000 103000 103000 0>;
	};

	/* front main sensor */
	qcom,cam-sensor2 {
		rgltr-min-voltage = <1136000 2850000 0>; /* DVDD 1.1 -> 1.136 V */
		rgltr-max-voltage = <1140000 2950000 0>;
	};
};
