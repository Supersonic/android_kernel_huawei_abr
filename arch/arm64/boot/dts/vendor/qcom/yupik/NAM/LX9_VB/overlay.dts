/dts-v1/;
/plugin/;

#include "../common/common.dtsi"
#include "huawei-nfc.dtsi"
#include "huawei_camera.dtsi"
#include "huawei_wifi.dtsi"
#include "huawei_dp.dtsi"

/ {
    /* bsp_replace_info @ model = "Huawei Technologies, Inc. %product_name%"; */
    model = "Huawei Technologies, Inc. NAM-LX9";
    compatible = "qcom,yupik-idp", "qcom,yupik", "qcom,idp";
    /* bsp_replace_info @ qcom,board-id = <%boardid% 0>; */
    qcom,board-id = <8537 0>;
};

&rootparam {
    /* bsp_replace_info @ qcom,boardid = <%boardid_split%>; */
    /* auto_key_info @ name: boardid type: uint32 default: 0 */
    qcom,boardid = <8 5 3 7>;
    /* bsp_replace_info @ qcom,board_name = "%board_name%"; */
    qcom,board_name = "NAM_LX9_VB";
    /* bsp_replace_info @ qcom,product_name = "%product_name%"; */
    qcom,product_name = "NTH_BID2101";
    /* bsp_replace_info @ hardware_version = "%hardware_version%"; */
    hardware_version = "HL1NTHM";
    /* bsp_replace_info @ huawei,modem_id = <%modem_id% 0x0>; */
    huawei,modem_id = <2101 0>;
};
