&qupv3_se0_i2c {
	status = "ok";
	aw869xx_haptic@5A {
		compatible = "awinic,awinic_haptic";
		reg = < 0x5A >;
		reset-gpio = <&tlmm 93 0>;
		irq-gpio = <&tlmm 90 0>;
		vib_mode = < 0 >; /* mode: RAM mode->0; CONT mode->1 */
		vib_f0_ref = < 1700 >;
		vib_f0_cali_percent = < 7 >;
		vib_cont_drv1_lvl = < 0x7F >;
		vib_cont_drv2_lvl = < 0x36 >;
		vib_cont_brk_time = < 0x06 >;
		vib_cont_tset = < 0x06 >;
		vib_cont_bemf_set = < 0x02 >;
		vib_cont_drv_width = < 0x6A >;
		vib_cont_wait_num = < 0x06 >;
		vib_cont_bst_brk_gain = < 0x05 >;
		vib_cont_brk_gain = < 0x08 >;
		vib_cont_drv1_time = < 0x04 >;
		vib_cont_drv2_time = < 0x14 >;
		vib_cont_track_margin = < 0x12 >;
		vib_sine_array = < 0x05 0xB2 0xFF 0xEF >;
		vib_d2s_gain = < 0x04 >;
		vib_bstcfg = < 0x20 0x24 0x9A 0x40 0x11 >;
		vib_prctmode = < 0x2D 0x3E 0x3F >;
		vib_trig_config = < 1 0 1 1 1 2 0 0
							1 0 0 1 0 2 0 0
							1 0 0 1 0 2 0 0 >;
		vib_is_enabled_auto_bst;
		vib_is_enabled_i2s;
		vib_is_enabled_powerup_f0_cali;
		status = "okay";
	};
	ams_as7341@39 {
		compatible = "ams,as7341";
		reg = <0x39>;
		flicker_support = <1>;
		algo_support = <1>;
		status = "ok";
	};
};

&pm8350b_haptics {
	vib_f0_ref = <235>;
	vib_f0_range = <8>;
	vibrator_effect_support;
	boost_power_alwayson = <1>;
};
