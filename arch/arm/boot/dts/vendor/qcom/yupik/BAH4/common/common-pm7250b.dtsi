#include "../../../yupik-idp-pm7250b.dtsi"
#include "../../common/huawei_dev_detect/huawei_dev_detect.dtsi"
#include "huawei_audio.dtsi"
#include "huawei_tp.dtsi"
#include "huawei_bsp.dtsi"
#include "huawei-lcd.dtsi"
#include "huawei_charger.dtsi"
#include "huawei-sensor.dtsi"
#include "huawei_fp.dtsi"
#include "huawei_fac.dtsi"
#include "huawei_sd.dtsi"
#include "huawei_camera.dtsi"
#include "huawei_dp.dtsi"
