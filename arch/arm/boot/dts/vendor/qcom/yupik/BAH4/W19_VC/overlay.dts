/dts-v1/;
/plugin/;

#include "../common/common-pm7250b.dtsi"
#include "huawei-nfc.dtsi"
#include "huawei_wifi.dtsi"
#include "huawei_dp.dtsi"
#include "huawei_charger.dtsi"
#include "huawei_bt.dtsi"
#include "huawei_gps.dtsi"
#include "../common/huawei_audio_bah4.dtsi"
#include "../common/huawei_mpss.dtsi"
#include "../common/huawei_ipa.dtsi"

/ {
    /* bsp_replace_info @ model = "Huawei Technologies, Inc. %product_name%"; */
    model = "Huawei Technologies, Inc. BAH4-W19";
    compatible = "qcom,yupik-idp", "qcom,yupik", "qcom,idp";
    /* bsp_replace_info @ qcom,board-id = <%boardid% 0>; */
    qcom,board-id = <8105 0>;
};

&rootparam {
    /* bsp_replace_info @ qcom,boardid = <%boardid_split%>; */
    /* auto_key_info @ name: boardid type: uint32 default: 0 */
    qcom,boardid = <8 1 0 5>;
    /* bsp_replace_info @ qcom,board_name = "%board_name%"; */
    qcom,board_name = "BAH4_W19_VC";
    /* bsp_replace_info @ qcom,product_name = "%product_name%"; */
    qcom,product_name = "BAH4_BID1102";
    /* bsp_replace_info @ hardware_version = "%hardware_version%"; */
    hardware_version = "SH1BAH4MA";
    /* bsp_replace_info @ huawei,modem_id = <%modem_id% 0x0>; */
    huawei,modem_id = <1102 0>;
};
